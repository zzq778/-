## firmware/esp32-c3/main/Kconfig.projbuild
```kconfig
menu "吉小知语音终端"
config JZX_WIFI_SSID
 string "Wi-Fi SSID"
 default ""
config JZX_WIFI_PASSWORD
 string "Wi-Fi password"
 default ""
config JZX_WORKER_URL
 string "Worker base URL"
 default "https://jizhengzhixing-official.pages.dev"
config JZX_DEVICE_TOKEN
 string "VOICE_DEVICE_TOKEN"
 default ""
config JZX_REGION
 string "Default region"
 default "长春市"
config JZX_VAD_THRESHOLD
 int "VAD RMS threshold"
 range 100 10000
 default 650
config JZX_MAX_TURN_SECONDS
 int "Maximum utterance length in seconds"
 range 2 8
 default 6
endmenu
```

## firmware/esp32-c3/sdkconfig.defaults
```kconfig
CONFIG_IDF_TARGET="esp32c3"
CONFIG_ESPTOOLPY_FLASHSIZE_4MB=y
CONFIG_ESP_MAIN_TASK_STACK_SIZE=8192
CONFIG_MBEDTLS_CERTIFICATE_BUNDLE=y
CONFIG_MBEDTLS_SSL_IN_CONTENT_LEN=4096
CONFIG_MBEDTLS_SSL_OUT_CONTENT_LEN=4096
```
